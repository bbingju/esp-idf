## components/curl/Kconfig
```kconfig
menuconfig CURL_LIBRARY
    bool "CURL Library"
    help
       Select this option to enable support for the libcurl,
       via the esp-idf component.
```

## components/wpc/Kconfig
```kconfig
menuconfig WIREPAS_LIBRARY
    bool "Wirepas Library"
    help
       Select this option to enable support for the Wirepas Dual-MCU API,
       via the esp-idf component for the Wirepas Connectivity.

config WIREPAS_UART_BUFSIZE
    int "Wirepas UART Buffer Size"
    depends on WIREPAS_LIBRARY
    default 2048
    range 64 2048
    help
	uart RX/TX buffer size

config WIREPAS_UART_BAUD_RATE
    int "Wirepas UART Buffer Baud Rate"
    depends on WIREPAS_LIBRARY
    default 115200
    range 115200 921600
    help
	uart RX/TX baudrate

config WIREPAS_UART_GPIO_TXD
    int "Wirepas UART TX Pin Number"
    depends on WIREPAS_LIBRARY
    default 10
    help
	UART TX pin number to connect the Wirepas Sink

config WIREPAS_UART_GPIO_RXD
    int "Wirepas UART RX Pin Number"
    depends on WIREPAS_LIBRARY
    default 9
    help
	UART RX pin number to connect the Wirepas Sink
```
